#include "miryoku/custom_config.h"
#include "miryoku/mapping/60/split_plank_60.h"
#include "miryoku/miryoku.dtsi"

/*
#include <behaviors.dtsi>
#include <dt-bindings/zmk/keys.h>
#include <dt-bindings/zmk/bt.h>
#include <dt-bindings/zmk/outputs.h>
#include <dt-bindings/zmk/backlight.h>
#include <dt-bindings/zmk/rgb.h>
#include <dt-bindings/zmk/ext_power.h>

#include "miryoku/miryoku.h"

#include "miryoku/miryoku_mousekeys.dtsi"
#include <dt-bindings/zmk/pointing.h>

#include "miryoku/miryoku_shift_functions.dtsi"

#include "miryoku/miryoku_double_tap_guard.dtsi"

#if defined (MIRYOKU_KLUDGE_THUMBCOMBOS)
  #include "miryoku/miryoku_kludge_thumbcombos.dtsi"
#endif

#if defined (MIRYOKU_KLUDGE_TOPROWCOMBOS)
  #include "miryoku/miryoku_kludge_toprowcombos.dtsi"
#endif

#if defined (MIRYOKU_KLUDGE_BOTTOMROWCOMBOS)
  #include "miryoku/miryoku_kludge_bottomrowcombos.dtsi"
#endif

#if defined (MIRYOKU_KLUDGE_NEEDCOMBOS)
  #include "miryoku/miryoku_kludge_needcombos.dtsi"
#endif

#include "miryoku/miryoku_behaviors.dtsi"
/*

/*
/ {
    keymap {
        compatible = "zmk,keymap";

        BASE {
            display-name = "Base";
            bindings = <

            &kp Q              &kp W             &kp E               &kp R               &kp T                U_NU                    U_NU                      &kp Y              &kp U              &kp I              &kp O              &kp P               
            U_MT(LGUI,  A)     U_MT(LALT,  S)    U_MT(LCTRL,  D)     U_MT(LSHFT,  F)     &kp G                U_NU                    U_NU                      &kp H              U_MT(RSHFT,  J)     U_MT(LCTRL,  K)     U_MT(LALT,  L)      U_MT(LGUI,  SQT)     
            U_LT(U_BUTTON,  Z) U_MT(RALT,  X)    &kp C               &kp V               &kp B                U_NU                    U_NU                      &kp N              &kp M              &kp COMMA          U_MT(RALT,  DOT)    U_LT(U_BUTTON,  SLASH)
            &kp Z              &kp Z             &kp Z               &kp Z               &kp Z                &kp Z                    &kp Z                     &kp Z              &kp Z              &kp Z              &kp Z              &kp Z                
            U_NU              U_NU             U_NU               U_LT(U_MEDIA,  ESC) U_LT(U_NAV,  SPACE) U_LT(U_MOUSE,  TAB)      U_LT(U_SYM,  RET)          U_LT(U_NUM,  BSPC)  U_LT(U_FUN,  DEL)    U_NU                U_NU                U_NU            
            
            >;
        };

        GAME {
            display-name = "Game";
            bindings = <
            
            &kp Q              &kp W              &kp E              &kp R              &kp T        U_NU                       U_NU         &kp Y              &kp U              &kp I              &kp O              &kp P               
            &kp A              &kp S              &kp D              &kp F              &kp G        U_NU                       U_NU         &kp H              &kp J              &kp K              &kp L              &kp SQT             
            &kp Z              &kp X              &kp C              &kp V              &kp B        U_NU                       U_NU         &kp N              &kp M              &kp COMMA          &kp DOT            &kp SLASH           
            &kp Z              &kp Z              &kp Z              &kp Z              &kp Z       &kp Z                     &kp Z        &kp Z               U_NU                U_NU                U_NU                U_NU                
            U_NU               U_NU               U_NU               &kp ESC            &kp SPACE   &kp TAB                   &kp RET      &kp BSPC           &kp DEL             U_NU                U_NU                U_NU

            >;
        };
            
        TAP {
            display-name = "Tap";
            bindings = <
            
            &kp Q              &kp W              &kp E              &kp R              &kp T        U_NU                       U_NU         &kp Y              &kp U              &kp I              &kp O              &kp P               
            &kp A              &kp S              &kp D              &kp F              &kp G        U_NU                       U_NU         &kp H              &kp J              &kp K              &kp L              &kp SQT             
            &kp Z              &kp X              &kp C              &kp V              &kp B        U_NU                       U_NU         &kp N              &kp M              &kp COMMA          &kp DOT            &kp SLASH           
             U_NU               U_NU               U_NU                U_NU                U_NU         U_NU                       U_NU          U_NU                U_NU                U_NU                U_NU               U_NU               
             U_NU                U_NU                U_NU               &kp ESC            &kp SPACE   &kp TAB                   &kp RET      &kp BSPC           &kp DEL             U_NU                U_NU                U_NU

            >;
        };

        BUTTON {
            display-name = "Button";
            bindings = <
            
            U_UND          U_CUT          U_CPY          U_PST          U_RDO         U_NU                       U_NU     U_RDO          U_PST          U_CPY          U_CUT          U_UND               
            &kp LGUI           &kp LALT           &kp LCTRL          &kp LSHFT          U_NU             U_NU                       U_NU     U_NU              &kp RSHFT          &kp LCTRL          &kp LALT           &kp LGUI            
            U_UND          U_CUT          U_CPY          U_PST          U_RDO         U_NU                       U_NU     U_RDO          U_PST          U_CPY          U_CUT          U_UND               
            U_NU              U_NU              U_NU              U_NU              U_NU             U_NU                       U_NU     U_NU              U_NU              U_NU              U_NU              U_NU               
            U_NU              U_NU              U_NU              &mkp MB3           &mkp MB1          &mkp MB2                    U_BTN2  U_BTN1           U_BTN3           U_NU              U_NU              U_NU

            >;
        };


        NAV {
            display-name = "Nav";
            bindings = <
            
            U_BOOT             &u_to_U_TAP        &u_to_U_EXTRA      &u_to_U_BASE       U_NU         U_NU                       U_NU         U_RDO              U_PST              U_CPY              U_CUT              U_UND               
            &kp LGUI           &kp LALT           &kp LCTRL          &kp LSHFT          U_NU         U_NU                       U_NU         &u_caps_word       &kp LEFT           &kp DOWN           &kp UP             &kp RIGHT           
            U_NU               &kp RALT           &u_to_U_NUM        &u_to_U_NAV        U_NU         U_NU                       U_NU         &kp INS            &kp HOME           &kp PG_DN          &kp PG_UP          &kp END             
             U_NU               U_NU              U_NU               U_NU               U_NU         U_NU                       U_NU          U_NU         U_NU                U_NU             U_NU               U_NU               
             U_NU                U_NU                U_NU                U_NU                U_NU         U_NU                      &kp RET            &kp BSPC           &kp DEL                U_NU                U_NU                U_NU

            >;
        };

        MOUSE {
            display-name = "Mouse";
            bindings =<
            
            U_BOOT             &u_to_U_TAP        &u_to_U_EXTRA      &u_to_U_BASE       U_NU         U_NU                       U_NU         U_RDO              U_PST              U_CPY              U_CUT              U_UND               
            &kp LGUI           &kp LALT           &kp LCTRL          &kp LSHFT          U_NU         U_NU                       U_NU          U_NU              U_MS_L            U_MS_D             U_MS_U             U_MS_R              
            U_NU               &kp RALT           &u_to_U_SYM        &u_to_U_MOUSE      U_NU         U_NU                       U_NU          U_NU              U_WH_L             U_WH_D             U_WH_U            U_WH_R              
             U_NU               U_NU              U_NU               U_NU               U_NU         U_NU                       U_NU          U_NU         U_NU                U_NU              U_NU               U_NU               
             U_NU                U_NU                U_NU                U_NU                U_NU         U_NU                  U_BTN2        U_BTN1            U_BTN3                U_NU                U_NU                U_NU

            >;
        };
        
        MEDIA {
            display-name = "Media";
            bindings =<
            
            U_BOOT             &u_to_U_TAP        &u_to_U_EXTRA      &u_to_U_BASE       U_NU          U_NU                       U_NU        U_RGB_TOG          U_RGB_EFF          U_RGB_HUI          U_RGB_SAI          U_RGB_BRI           
            &kp LGUI           &kp LALT           &kp LCTRL          &kp LSHFT          U_NU          U_NU                       U_NU        U_EP_TOG           &kp C_PREV         &kp C_VOL_DN       &kp C_VOL_UP       &kp C_NEXT          
            U_NU               &kp RALT           &u_to_U_FUN        &u_to_U_MEDIA      U_NU          U_NU                       U_NU        &u_out_tog         &u_bt_sel_0        &u_bt_sel_1        &u_bt_sel_2        &u_bt_sel_3         
             U_NU               U_NU              U_NU               U_NU               U_NU          U_NU                       U_NU         U_NU         U_NU                U_NU          U_NU               U_NU               
             U_NU                U_NU                U_NU                U_NU                U_NU          U_NU                      &kp C_STOP         &kp C_PP           &kp C_MUTE                U_NU                U_NU                U_NU

            >;
        };
        
        NUM {
            display-name = "Num";
            bindings =<
            
            &kp LBKT           &kp N7             &kp N8             &kp N9             &kp RBKT      U_NU                       U_NU        U_NU               &u_to_U_BASE       &u_to_U_EXTRA      &u_to_U_TAP        U_BOOT              
            &kp SEMI           &kp N4             &kp N5             &kp N6             &kp EQUAL     U_NU                       U_NU        U_NU               &kp LSHFT          &kp LCTRL          &kp LALT           &kp LGUI            
            &kp GRAVE          &kp N1             &kp N2             &kp N3             &kp BSLH      U_NU                       U_NU        U_NU               &u_to_U_NUM        &u_to_U_NAV        &kp RALT           U_NU                
             U_NU               U_NU               U_NU                U_NU                U_NU          U_NU                       U_NU        U_NU               U_NU               U_NU                U_NU               U_NU               
             U_NU                U_NU                U_NU               &kp DOT            &kp N0       &kp MINUS                  U_NU         U_NU                U_NU                U_NU                U_NU                U_NU

            >;
        };
        
        SYM {
            display-name = "Sym";
            bindings =<
            
            &kp LBRC           &kp AMPS           &kp ASTRK          &kp LPAR           &kp RBRC       U_NU                       U_NU       U_NU               &u_to_U_BASE       &u_to_U_EXTRA      &u_to_U_TAP        U_BOOT              
            &kp COLON          &kp DLLR           &kp PRCNT          &kp CARET          &kp PLUS       U_NU                       U_NU       U_NU               &kp LSHFT          &kp LCTRL          &kp LALT           &kp LGUI            
            &kp TILDE          &kp EXCL           &kp AT             &kp HASH           &kp PIPE       U_NU                       U_NU       U_NU               &u_to_U_SYM        &u_to_U_MOUSE      &kp RALT           U_NU                
             U_NU               U_NU               U_NU                U_NU                U_NU           U_NU                       U_NU       U_NU               U_NU               U_NU                U_NU               U_NU               
             U_NU                U_NU                U_NU               &kp LPAR           &kp RPAR      &kp UNDER                  U_NU        U_NU                U_NU                U_NU                U_NU                U_NU

            >;
        };
        

        FUN {
            display-name = "Fun";
            bindings =<
            
            &kp F12            &kp F7             &kp F8             &kp F9             &kp PSCRN         U_NU                       U_NU    U_NU               &u_to_U_BASE       &u_to_U_EXTRA      &u_to_U_TAP        U_BOOT              
            &kp F11            &kp F4             &kp F5             &kp F6             &kp SLCK          U_NU                       U_NU    U_NU               &kp LSHFT          &kp LCTRL          &kp LALT           &kp LGUI            
            &kp F10            &kp F1             &kp F2             &kp F3             &kp PAUSE_BREAK   U_NU                       U_NU    U_NU               &u_to_U_FUN        &u_to_U_MEDIA      &kp RALT           U_NU                
             U_NU               U_NU               U_NU                U_NU                U_NU              U_NU                       U_NU    U_NU               U_NU               U_NU                U_NU               U_NU               
             U_NU                U_NU                U_NU               &kp K_APP          &kp SPACE        &kp TAB                    U_NU     U_NU                U_NU                U_NU                U_NU                U_NU

            >;
        };
    };
};
*/


/ {
  keymap {
    compatible = "zmk,keymap";
#define MIRYOKU_X(LAYER, STRING) \
    LAYER { \
      display-name = STRING; \
      bindings = < U_MACRO_VA_ARGS(MIRYOKU_LAYERMAPPING_##LAYER, MIRYOKU_LAYER_##LAYER) >; \
    };
MIRYOKU_LAYER_LIST
#undef MIRYOKU_X
  };
};

 
/*
/ {
  keymap {
    compatible = "zmk,keymap";
    BASE_FROW {
      display-name = "BaseF";
      bindings = < U_MACRO_VA_ARGS(MIRYOKU_LAYERMAPPING_BASE_FROW, MIRYOKU_LAYER_BASE_FROW) >;
    };

    EXTRA_FROW {
      display-name = "ExtraF";
      bindings = < U_MACRO_VA_ARGS(MIRYOKU_LAYERMAPPING_EXTRA_FROW, MIRYOKU_LAYER_EXTRA_FROW) >;
    };

    TAP_FROW {
      display-name = "TapF";
      bindings = < U_MACRO_VA_ARGS(MIRYOKU_LAYERMAPPING_TAP_FROW, MIRYOKU_LAYER_TAP_FROW) >;
    };

    BUTTON_FROW {
      display-name = "ButtonF";
      bindings = < U_MACRO_VA_ARGS(MIRYOKU_LAYERMAPPING_BUTTON_FROW, MIRYOKU_LAYER_BUTTON_FROW) >;
    };

    NAV_FROW {
      display-name = "NavF";
      bindings = < U_MACRO_VA_ARGS(MIRYOKU_LAYERMAPPING_NAV_FROW, MIRYOKU_LAYER_NAV_FROW) >;
    };

    MOUSE_FROW {
      display-name = "MouseF";
      bindings = < U_MACRO_VA_ARGS(MIRYOKU_LAYERMAPPING_MOUSE_FROW, MIRYOKU_LAYER_MOUSE_FROW) >;
    };

    MEDIA_FROW {
      display-name = "MediaF";
      bindings = < U_MACRO_VA_ARGS(MIRYOKU_LAYERMAPPING_MEDIA_FROW, MIRYOKU_LAYER_MEDIA_FROW) >;
    };

    NUM_FROW {
      display-name = "NumF";
      bindings = < U_MACRO_VA_ARGS(MIRYOKU_LAYERMAPPING_NUM_FROW, MIRYOKU_LAYER_NUM_FROW) >;
    };

    SYM_FROW {
      display-name = "SymF";
      bindings = < U_MACRO_VA_ARGS(MIRYOKU_LAYERMAPPING_SYM_FROW, MIRYOKU_LAYER_SYM_FROW) >;
    };

    FUN_FROW {
      display-name = "FunF";
      bindings = < U_MACRO_VA_ARGS(MIRYOKU_LAYERMAPPING_FUN_FROW, MIRYOKU_LAYER_FUN_FROW) >;
    };
    
    BASE {
      display-name = "Base";
      bindings = < U_MACRO_VA_ARGS(MIRYOKU_LAYERMAPPING_BASE, MIRYOKU_LAYER_BASE) >;
    };

    EXTRA {
      display-name = "Extra";
      bindings = < U_MACRO_VA_ARGS(MIRYOKU_LAYERMAPPING_EXTRA, MIRYOKU_LAYER_EXTRA) >;
    };

    TAP {
      display-name = "Tap";
      bindings = < U_MACRO_VA_ARGS(MIRYOKU_LAYERMAPPING_TAP, MIRYOKU_LAYER_TAP) >;
    };

    BUTTON {
      display-name = "Button";
      bindings = < U_MACRO_VA_ARGS(MIRYOKU_LAYERMAPPING_BUTTON, MIRYOKU_LAYER_BUTTON) >;
    };

    NAV {
      display-name = "Nav";
      bindings = < U_MACRO_VA_ARGS(MIRYOKU_LAYERMAPPING_NAV, MIRYOKU_LAYER_NAV) >;
    };

    MOUSE {
      display-name = "Mouse";
      bindings = < U_MACRO_VA_ARGS(MIRYOKU_LAYERMAPPING_MOUSE, MIRYOKU_LAYER_MOUSE) >;
    };

    MEDIA {
      display-name = "Media";
      bindings = < U_MACRO_VA_ARGS(MIRYOKU_LAYERMAPPING_MEDIA, MIRYOKU_LAYER_MEDIA) >;
    };

    NUM {
      display-name = "Num";
      bindings = < U_MACRO_VA_ARGS(MIRYOKU_LAYERMAPPING_NUM, MIRYOKU_LAYER_NUM) >;
    };

    SYM {
      display-name = "Sym";
      bindings = < U_MACRO_VA_ARGS(MIRYOKU_LAYERMAPPING_SYM, MIRYOKU_LAYER_SYM) >;
    };

    FUN {
      display-name = "Fun";
      bindings = < U_MACRO_VA_ARGS(MIRYOKU_LAYERMAPPING_FUN, MIRYOKU_LAYER_FUN) >;
    };

    GAME {
      display-name = "Game";
      bindings = < U_MACRO_VA_ARGS(MIRYOKU_LAYERMAPPING_GAME, MIRYOKU_LAYER_GAME) >;
    };

  };
};
*/
