## boards/shields/splitPlank60/Kconfig.defconfig
```kconfig
if SHIELD_SPLITPLANK60_LEFT

config ZMK_KEYBOARD_NAME
    default "splitPlank60"

config ZMK_SPLIT_ROLE_CENTRAL
    default y

endif

if SHIELD_SPLITPLANK60_LEFT || SHIELD_SPLITPLANK60_RIGHT

config ZMK_SPLIT
    default y

endif
```

## boards/shields/splitPlank60/Kconfig.shield
```kconfig
config SHIELD_SPLITPLANK60_LEFT
    def_bool $(shields_list_contains,split_plank_60_left)

config SHIELD_SPLITPLANK60_RIGHT
    def_bool $(shields_list_contains,split_plank_60_right)
    
```

## config/boards/shields/manos_split/Kconfig.defconfig
```kconfig
if SHIELD_MANOS_SPLIT_LEFT

config ZMK_KEYBOARD_NAME
    default "ManosSplit5x6"

config ZMK_SPLIT_ROLE_CENTRAL
    default y

endif

if SHIELD_MANOS_SPLIT_LEFT || SHIELD_MANOS_SPLIT_RIGHT

config ZMK_SPLIT
    default y

config ZMK_PM_SOFT_OFF
    default y

config ZMK_POINTING
    default y
    
endif
```

## config/boards/shields/manos_split/Kconfig.shield
```kconfig
config SHIELD_MANOS_SPLIT_LEFT
    def_bool $(shields_list_contains,manos_split_left5x6)

config SHIELD_MANOS_SPLIT_RIGHT
    def_bool $(shields_list_contains,manos_split_right5x6)
    
```
