// Copyright 2022 Manna Harbour
// https://github.com/manna-harbour/miryoku

#define MIRYOKU_X(CODE, EMPTY) \
MIRYOKU_TAPDELAY_TAP(CODE##EMPTY) \
MIRYOKU_TAPDELAY_MT(CODE##EMPTY) \
MIRYOKU_TAPDELAY_LT(CODE##EMPTY) \
MIRYOKU_TAPDELAY_LT(CODE##EMPTY)

MIRYOKU_TAPDELAY_LIST

#undef MIRYOKU_X

/ {
  macros {
    u_tapdelay_tap_u_bspc_del: u_tapdelay_tap_u_bspc_del {
      compatible = "zmk,behavior-macro";
      #binding-cells = <0>;
      bindings = <&macro_press &u_bspc_del>, <&macro_release &u_bspc_del>;
    };
  };
};
/ {
  behaviors {
    u_tapdelay_mt_u_bspc_del: u_tapdelay_mt_u_bspc_del {
      compatible = "zmk,behavior-hold-tap";
      #binding-cells = <2>;
      tapping-term-ms = <U_TAPPING_TERM>;
      flavor = "tap-preferred";
      bindings = <&kp>, <&u_tapdelay_tap_u_bspc_del>;
    };
  };
};


/ {
  behaviors {
    u_tapdelay_lt_u_bspcu_bspc_del: u_tapdelay_lt_u_bspc_del {
      compatible = "zmk,behavior-hold-tap";
      #binding-cells = <2>;
      tapping-term-ms = <U_TAPPING_TERM>;
      flavor = "tap-preferred";
      bindings = <&mo>, <&u_tapdelay_tap_u_bspc_del>;
    };
  };
};

/ {
  behaviors {
    u_tapdelay_kp_u_bspcu_bspc_del: u_tapdelay_kp_u_bspc_del {
      compatible = "zmk,behavior-hold-tap";
      #binding-cells = <2>;
      tapping-term-ms = <U_TAPPING_TERM>;
      flavor = "tap-preferred";
      bindings = <&key_repeat>, <&u_tapdelay_tap_u_bspc_del>;
    };
  };
};
